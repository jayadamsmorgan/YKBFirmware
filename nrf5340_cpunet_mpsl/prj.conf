## CMakeLists.txt
```
cmake_minimum_required(VERSION 3.20.0)

find_package(Zephyr REQUIRED HINTS $ENV{ZEPHYR_BASE})

project(app LANGUAGES C)

target_sources(app PRIVATE
  src/main.c
  src/app_esb.c
  src/esb.c
  src/hci_rpmsg_module.c
  src/timeslot_handler.c
)
```

## prj.conf
```kconfig
CONFIG_UART_CONSOLE=n
CONFIG_SERIAL=n
CONFIG_CONSOLE=n
CONFIG_BOOT_BANNER=n
CONFIG_NCS_BOOT_BANNER=n
CONFIG_LOG=n
CONFIG_PRINTK=n

CONFIG_MPSL=y
CONFIG_MPSL_TIMESLOT_SESSION_COUNT=1

CONFIG_BT=y

CONFIG_ESB=y

CONFIG_LIB_ESB_BLE_MPSL=y

CONFIG_SYSTEM_WORKQUEUE_STACK_SIZE=2048
CONFIG_HEAP_MEM_POOL_SIZE=8192
CONFIG_MAIN_STACK_SIZE=4096
CONFIG_NRF_RPC_THREAD_STACK_SIZE=4096

CONFIG_BT_MAX_CONN=4
CONFIG_BT_CTLR_ASSERT_HANDLER=y
```

## src/main.c
```c
#include <zephyr/console/console.h>
#include <zephyr/kernel.h>
#include <zephyr/logging/log.h>
#include <zephyr/sys/printk.h>
#include <zephyr/types.h>

#include <esb.h>

#include <zephyr/drivers/gpio.h>

#include <lib/esb_ble_mpsl.h>

LOG_MODULE_REGISTER(main, LOG_LEVEL_INF);

int main(void) {

    mpsl_hci_rpmsg_init();

    while (1) {
        k_sleep(K_MSEC(2000));
    }
}
```

## src/app_esb.h
```c
#ifndef __APP_ESB_H
#define __APP_ESB_H

#include <zephyr/kernel.h>

typedef enum {
    APP_ESB_EVT_TX_SUCCESS,
    APP_ESB_EVT_TX_FAIL,
    APP_ESB_EVT_RX
} app_esb_event_type_t;
typedef enum { APP_ESB_MODE_PTX, APP_ESB_MODE_PRX } app_esb_mode_t;

typedef struct {
    app_esb_event_type_t evt_type;
    uint8_t *buf;
    uint32_t data_length;
} app_esb_event_t;

typedef struct {
    uint8_t data[32];
    uint32_t len;
} app_esb_data_t;

typedef struct {
    app_esb_mode_t mode;
} app_esb_config_t;

typedef void (*app_esb_callback_t)(app_esb_event_t *event);

struct esb_simple_addr {
    uint8_t base_0[4];
    uint8_t base_1[4];
    uint8_t prefix[8];
};

int app_esb_init(app_esb_mode_t mode, app_esb_callback_t callback);

int app_esb_send(app_esb_data_t *tx_packet);

#endif
```

## src/esb.c
```c
#include <zephyr/init.h>
#include <zephyr/kernel.h>
#include <zephyr/logging/log.h>
#include <zephyr/types.h>

#include "app_esb.h"
#include "esb_rpc_ids.h"

#include <esb.h>
#include <mdk/nrf.h>

#include <nrf_rpc/nrf_rpc_ipc.h>
#include <nrf_rpc_cbor.h>

#include <zcbor_common.h>
#include <zcbor_decode.h>
#include <zcbor_encode.h>

#define CBOR_BUF_SIZE 16

LOG_MODULE_REGISTER(rpc_net, LOG_LEVEL_DBG);

NRF_RPC_IPC_TRANSPORT(esb_group_tr, DEVICE_DT_GET(DT_NODELABEL(ipc0)),
                      "nrf_rpc_ept");
NRF_RPC_GROUP_DEFINE(esb_group, "esb_group_id", &esb_group_tr, NULL, NULL,
                     NULL);

static void rpc_esb_event_send(uint32_t evt_type, uint8_t *rx_payload_buf,
                               uint32_t rx_payload_length);

static void work_send_evt_tx_success_func(struct k_work *item);
static void work_send_evt_tx_fail_func(struct k_work *item);
static void work_send_evt_rx_received_func(struct k_work *item);

K_WORK_DEFINE(m_work_send_evt_tx_success, work_send_evt_tx_success_func);
K_WORK_DEFINE(m_work_send_evt_tx_fail, work_send_evt_tx_fail_func);
K_WORK_DEFINE(m_work_send_evt_rx_received, work_send_evt_rx_received_func);

static uint8_t *last_rx_buf;
static uint32_t last_rx_length;

void on_esb_callback(app_esb_event_t *event) {
    switch (event->evt_type) {
    case APP_ESB_EVT_TX_SUCCESS:
        LOG_INF("ESB TX success");
        k_work_submit(&m_work_send_evt_tx_success);
        break;
    case APP_ESB_EVT_TX_FAIL:
        LOG_INF("ESB TX failed");
        k_work_submit(&m_work_send_evt_tx_fail);
        break;
    case APP_ESB_EVT_RX:
        LOG_INF("ESB RX: 0x%.2x-0x%.2x-0x%.2x-0x%.2x", event->buf[0],
                event->buf[1], event->buf[2], event->buf[3]);
        last_rx_buf = event->buf;
        last_rx_length = event->data_length;
        k_work_submit(&m_work_send_evt_rx_received);
        break;
    default:
        LOG_ERR("Unknown APP ESB event!");
        break;
    }
}

static void work_send_evt_tx_success_func(struct k_work *item) {
    rpc_esb_event_send(APP_ESB_EVT_TX_SUCCESS, 0, 0);
}

static void work_send_evt_tx_fail_func(struct k_work *item) {
    rpc_esb_event_send(APP_ESB_EVT_TX_FAIL, 0, 0);
}

static void work_send_evt_rx_received_func(struct k_work *item) {
    rpc_esb_event_send(APP_ESB_EVT_RX, last_rx_buf, last_rx_length);
}

static int decode_struct(struct nrf_rpc_cbor_ctx *ctx, void *struct_ptr,
                         size_t expected_size) {
    struct zcbor_string zst;
    int err;

    if (zcbor_bstr_decode(ctx->zs, &zst)) {
        err = 0;
    } else {
        err = -EBADMSG;
    }

    if (expected_size != zst.len) {
        LOG_ERR("struct size mismatch: expect %d got %d", expected_size,
                zst.len);
        err = -EMSGSIZE;
    }

    if (!err) {
        memcpy(struct_ptr, zst.value, zst.len);
    } else {
        LOG_ERR("decoding failed");
    }

    return err;
}

/* Encode and send the return value (errcode) of `esb_simple_init`. */
static void rpc_rsp(int32_t err) {
    struct nrf_rpc_cbor_ctx ctx;

    NRF_RPC_CBOR_ALLOC(&esb_group, ctx, CBOR_BUF_SIZE);

    zcbor_int32_put(ctx.zs, err);

    nrf_rpc_cbor_rsp_no_err(&esb_group, &ctx);
}

/* `esb_simple_init` RPC command handler.
 *
 * This will get called when the other core sends an nRF RPC command for the
 * group `esb_group` with command ID `RPC_COMMAND_INIT`.
 *
 * This command handler is registered using `NRF_RPC_CBOR_CMD_DECODER` at the
 * bottom of this file.
 */
static void rpc_esb_init_handler(const struct nrf_rpc_group *group,
                                 struct nrf_rpc_cbor_ctx *ctx,
                                 void *handler_data) {
    LOG_DBG("");

    int32_t err = 0;
    app_esb_config_t config;

    if (decode_struct(ctx, &config, sizeof(config))) {
        LOG_DBG("decoding config struct failed");
        err = -EBADMSG;
    }

    /* Call this as soon as the data has been pulled from the RPC CBOR buffer.
     *
     * This is important because nRF RPC will not be able to process another
     * command (sent from the other core) until `nrf_rpc_cbor_decoding_done`
     * has been called.
     *
     * The underlying reason is that nRF RPC over IPC will process incoming
     * items in a workqueue, and an item is only marked as processed when
     * this function is called (freeing the workqueue for the next one).
     */
    nrf_rpc_cbor_decoding_done(group, ctx);

    if (!err) {
        LOG_DBG("app_esb_init. Mode %i", config.mode);
        err = app_esb_init(config.mode, on_esb_callback);
        if (err) {
            LOG_ERR("app_esb init failed (err %d)", err);
        }
    }

    /* Encode the errcode and send it to the other core. */
    rpc_rsp(err);
}

static void rpc_esb_tx_handler(const struct nrf_rpc_group *group,
                               struct nrf_rpc_cbor_ctx *ctx,
                               void *handler_data) {
    int err = 0;
    app_esb_data_t tx_payload;

    if (decode_struct(ctx, &tx_payload, sizeof(tx_payload))) {
        LOG_DBG("decoding app_esb_data_t struct failed");
        err = -EBADMSG;
    }

    nrf_rpc_cbor_decoding_done(&esb_group, ctx);

    if (!err) {
        LOG_INF("Send TX packet, data 0 0x%.2x, len %i", tx_payload.data[0],
                tx_payload.len);
        err = app_esb_send(&tx_payload);
        if (err < 0) {
            LOG_ERR("app_esb_send: error %i", err);
        }
    }

    rpc_rsp(err);
}

/* This is the callback passed to the esb_simple API, which
 * then calls the RPC remote callback (sends an event).
 *
 * On the remote (app core), the rpc event will then call
 * the function stored in p_rx_cb_remote.
 */
static void rpc_esb_event_send(uint32_t evt_type, uint8_t *rx_buf,
                               uint32_t rx_length) {
    int err = 0;
    struct nrf_rpc_cbor_ctx ctx;

    NRF_RPC_CBOR_ALLOC(&esb_group, ctx,
                       CBOR_BUF_SIZE + sizeof(err) + sizeof(evt_type) +
                           sizeof(uint32_t) + rx_length);

    /* Always encode the error */
    if (!zcbor_int32_put(ctx.zs, err)) {
        err = -EINVAL;
    }

    if (err || !zcbor_uint32_put(ctx.zs, evt_type)) {
        err = -EINVAL;
    }

    if (err || !zcbor_uint32_put(ctx.zs, rx_length)) {
        err = -EINVAL;
    }

    if (rx_length > 0) {
        if (err || !zcbor_bstr_encode_ptr(ctx.zs, rx_buf, rx_length)) {
            err = -EINVAL;
        }
    }

    if (!err) {
        err = nrf_rpc_cbor_evt(&esb_group, RPC_EVENT_ESB_CB, &ctx);
    }

    if (!err) {
        LOG_DBG("evt send ok");
    } else {
        LOG_DBG("evt send err %d", err);
    }
}

NRF_RPC_CBOR_CMD_DECODER(esb_group, rpc_esb_init, RPC_COMMAND_ESB_INIT,
                         rpc_esb_init_handler, NULL);
NRF_RPC_CBOR_CMD_DECODER(esb_group, rpc_esb_tx, RPC_COMMAND_ESB_TX,
                         rpc_esb_tx_handler, NULL);

static void err_handler(const struct nrf_rpc_err_report *report) {
    LOG_ERR("nRF RPC error %d. Enable nRF RPC logs for details.", report->code);
    k_oops();
}

static int serialization_init(void) {
    int err;

    LOG_DBG("nRF RPC init begin");

    err = nrf_rpc_init(err_handler);
    if (err) {
        return -EINVAL;
    }

    LOG_DBG("nRF RPC init ok");

    return 0;
}

SYS_INIT(serialization_init, POST_KERNEL, CONFIG_APPLICATION_INIT_PRIORITY);
```

## src/hci_rpmsg_module.c
```c
#include "hci_rpmsg_module.h"
#include <stddef.h>
#include <stdio.h>
#include <string.h>

#include <zephyr/device.h>
#include <zephyr/kernel.h>
#include <zephyr/sys/byteorder.h>
#include <zephyr/sys/util.h>

#include <zephyr/ipc/ipc_service.h>

#include <zephyr/bluetooth/bluetooth.h>
#include <zephyr/bluetooth/buf.h>
#include <zephyr/bluetooth/hci.h>
#include <zephyr/bluetooth/hci_raw.h>
#include <zephyr/bluetooth/hci_vs.h>
#include <zephyr/bluetooth/l2cap.h>
#include <zephyr/net_buf.h>

#include <zephyr/logging/log.h>
#include <zephyr/logging/log_ctrl.h>

LOG_MODULE_REGISTER(hci_rpmsg, LOG_LEVEL_INF); // CONFIG_BT_LOG_LEVEL);

static struct ipc_ept hci_ept;

static K_THREAD_STACK_DEFINE(tx_thread_stack, CONFIG_BT_HCI_TX_STACK_SIZE);
static struct k_thread tx_thread_data;
static K_THREAD_STACK_DEFINE(rx_thread_stack, 1024);
static struct k_thread rx_thread_data;
static K_FIFO_DEFINE(tx_queue);
static K_SEM_DEFINE(ipc_bound_sem, 0, 1);
#if defined(CONFIG_BT_CTLR_ASSERT_HANDLER) ||                                  \
    defined(CONFIG_BT_HCI_VS_FATAL_ERROR)
/* A flag used to store information if the IPC endpoint has already been bound.
 * The end point can't be used before that happens.
 */
static bool ipc_ept_ready;
#endif /* CONFIG_BT_CTLR_ASSERT_HANDLER || CONFIG_BT_HCI_VS_FATAL_ERROR */

#define HCI_RPMSG_CMD 0x01
#define HCI_RPMSG_ACL 0x02
#define HCI_RPMSG_SCO 0x03
#define HCI_RPMSG_EVT 0x04
#define HCI_RPMSG_ISO 0x05

#define HCI_FATAL_ERR_MSG true
#define HCI_REGULAR_MSG false

static struct net_buf *hci_rpmsg_cmd_recv(uint8_t *data, size_t remaining) {
    struct bt_hci_cmd_hdr *hdr = (void *)data;
    struct net_buf *buf;

    if (remaining < sizeof(*hdr)) {
        LOG_ERR("Not enough data for command header");
        return NULL;
    }

    buf = bt_buf_get_tx(BT_BUF_CMD, K_NO_WAIT, hdr, sizeof(*hdr));
    if (buf) {
        data += sizeof(*hdr);
        remaining -= sizeof(*hdr);
    } else {
        LOG_ERR("No available command buffers!");
        return NULL;
    }

    if (remaining != hdr->param_len) {
        LOG_ERR("Command payload length is not correct");
        net_buf_unref(buf);
        return NULL;
    }

    if (remaining > net_buf_tailroom(buf)) {
        LOG_ERR("Not enough space in buffer");
        net_buf_unref(buf);
        return NULL;
    }

    LOG_DBG("len %u", hdr->param_len);
    net_buf_add_mem(buf, data, remaining);

    return buf;
}

static struct net_buf *hci_rpmsg_acl_recv(uint8_t *data, size_t remaining) {
    struct bt_hci_acl_hdr *hdr = (void *)data;
    struct net_buf *buf;

    if (remaining < sizeof(*hdr)) {
        LOG_ERR("Not enough data for ACL header");
        return NULL;
    }

    buf = bt_buf_get_tx(BT_BUF_ACL_OUT, K_NO_WAIT, hdr, sizeof(*hdr));
    if (buf) {
        data += sizeof(*hdr);
        remaining -= sizeof(*hdr);
    } else {
        LOG_ERR("No available ACL buffers!");
        return NULL;
    }

    if (remaining != sys_le16_to_cpu(hdr->len)) {
        LOG_ERR("ACL payload length is not correct");
        net_buf_unref(buf);
        return NULL;
    }

    if (remaining > net_buf_tailroom(buf)) {
        LOG_ERR("Not enough space in buffer");
        net_buf_unref(buf);
        return NULL;
    }

    LOG_DBG("len %u", remaining);
    net_buf_add_mem(buf, data, remaining);

    return buf;
}

static struct net_buf *hci_rpmsg_iso_recv(uint8_t *data, size_t remaining) {
    struct bt_hci_iso_hdr *hdr = (void *)data;
    struct net_buf *buf;

    if (remaining < sizeof(*hdr)) {
        LOG_ERR("Not enough data for ISO header");
        return NULL;
    }

    buf = bt_buf_get_tx(BT_BUF_ISO_OUT, K_NO_WAIT, hdr, sizeof(*hdr));
    if (buf) {
        data += sizeof(*hdr);
        remaining -= sizeof(*hdr);
    } else {
        LOG_ERR("No available ISO buffers!");
        return NULL;
    }

    if (remaining != bt_iso_hdr_len(sys_le16_to_cpu(hdr->len))) {
        LOG_ERR("ISO payload length is not correct");
        net_buf_unref(buf);
        return NULL;
    }

    if (remaining > net_buf_tailroom(buf)) {
        LOG_ERR("Not enough space in buffer");
        net_buf_unref(buf);
        return NULL;
    }

    LOG_DBG("len %zu", remaining);
    net_buf_add_mem(buf, data, remaining);

    return buf;
}

static void hci_rpmsg_rx(uint8_t *data, size_t len) {
    uint8_t pkt_indicator;
    struct net_buf *buf = NULL;
    size_t remaining = len;

    LOG_HEXDUMP_DBG(data, len, "RPMSG data:");

    pkt_indicator = *data++;
    remaining -= sizeof(pkt_indicator);

    switch (pkt_indicator) {
    case HCI_RPMSG_CMD:
        buf = hci_rpmsg_cmd_recv(data, remaining);
        break;

    case HCI_RPMSG_ACL:
        buf = hci_rpmsg_acl_recv(data, remaining);
        break;

    case HCI_RPMSG_ISO:
        buf = hci_rpmsg_iso_recv(data, remaining);
        break;

    default:
        LOG_ERR("Unknown HCI type %u", pkt_indicator);
        return;
    }

    if (buf) {
        k_fifo_put(&tx_queue, buf);

        LOG_HEXDUMP_DBG(buf->data, buf->len, "Final net buffer:");
    }
}

static void tx_thread(void *p1, void *p2, void *p3) {
    while (1) {
        struct net_buf *buf;
        int err;

        /* Wait until a buffer is available */
        buf = k_fifo_get(&tx_queue, K_FOREVER);
        /* Pass buffer to the stack */
        err = bt_send(buf);
        if (err) {
            LOG_ERR("Unable to send (err %d)", err);
            net_buf_unref(buf);
        }

        /* Give other threads a chance to run if tx_queue keeps getting
         * new data all the time.
         */
        k_yield();
    }
}

static void hci_rpmsg_send(struct net_buf *buf, bool is_fatal_err) {
    uint8_t pkt_indicator;
    uint8_t retries = 0;
    int ret;

    enum bt_buf_type buf_type =
        bt_buf_type_from_h4(net_buf_pull_u8(buf), BT_BUF_OUT);

    LOG_DBG("buf %p type %u len %u", buf, buf_type, buf->len);

    LOG_HEXDUMP_DBG(buf->data, buf->len, "Controller buffer:");

    switch (buf_type) {
    case BT_BUF_ACL_IN:
        pkt_indicator = HCI_RPMSG_ACL;
        break;
    case BT_BUF_EVT:
        pkt_indicator = HCI_RPMSG_EVT;
        break;
    case BT_BUF_ISO_IN:
        pkt_indicator = HCI_RPMSG_ISO;
        break;
    default:
        LOG_ERR("Unknown type %u", buf_type);
        net_buf_unref(buf);
        return;
    }
    net_buf_push_u8(buf, pkt_indicator);

    LOG_HEXDUMP_DBG(buf->data, buf->len, "Final HCI buffer:");

    do {
        ret = ipc_service_send(&hci_ept, buf->data, buf->len);
        if (ret < 0) {
            retries++;
            if (retries > 10) {
                /* Default backend (rpmsg_virtio) has a timeout of 150ms. */
                LOG_WRN("IPC send has been blocked for 1.5 seconds.");
                retries = 0;
            }

            /* The function can be called by the application main thread,
             * bt_ctlr_assert_handle and k_sys_fatal_error_handler. In case of a
             * call by Bluetooth Controller assert handler or system fatal error
             * handler the call can be from ISR context, hence there is no
             * thread to yield. Besides that both handlers implement a policy to
             * provide error information and stop the system in an infinite
             * loop. The goal is to prevent any other damage to the system if
             * one of such exeptional situations occur, hence call to k_yield is
             * against it.
             */
            if (is_fatal_err) {
                LOG_ERR("IPC service send error: %d", ret);
            } else {
                k_yield();
            }
        }
    } while (ret < 0);

    LOG_DBG("Sent message of %d bytes.", ret);

    net_buf_unref(buf);
}

/* incoming events and data from the controller */
static K_FIFO_DEFINE(rx_queue);

static void rx_thread(void *p1, void *p2, void *p3) {
    /* incoming events and data from the controller */
    // static K_FIFO_DEFINE(rx_queue);

    k_sem_take(&ipc_bound_sem, K_FOREVER);

    /* Enable the raw interface, this will in turn open the HCI driver */
    // bt_enable_raw(&rx_queue);

    while (1) {
        struct net_buf *buf;

        buf = k_fifo_get(&rx_queue, K_FOREVER);
        NRF_P0->OUTSET = BIT(30);
        hci_rpmsg_send(buf, HCI_REGULAR_MSG);
        NRF_P0->OUTCLR = BIT(30);
    }
}

#if defined(CONFIG_BT_CTLR_ASSERT_HANDLER)
void bt_ctlr_assert_handle(char *file, uint32_t line) {
    /* Disable interrupts, this is unrecoverable */
    (void)irq_lock();

#if defined(CONFIG_BT_HCI_VS_FATAL_ERROR)
    /* Generate an error event only when IPC service endpoint is already bound.
     */
    if (ipc_ept_ready) {
        /* Prepare vendor specific HCI debug event */
        struct net_buf *buf;

        buf = hci_vs_err_assert(file, line);
        if (buf != NULL) {
            /* Send the event over rpmsg */
            hci_rpmsg_send(buf, HCI_FATAL_ERR_MSG);
        } else {
            LOG_ERR("Can't create Fatal Error HCI event: %s at %d", __FILE__,
                    __LINE__);
        }
    } else {
        LOG_ERR("IPC endpoint is not ready yet: %s at %d", __FILE__, __LINE__);
    }

    LOG_ERR("Halting system");

#else /* !CONFIG_BT_HCI_VS_FATAL_ERROR */
    LOG_ERR("Controller assert in: %s at %d", file, line);

#endif /* !CONFIG_BT_HCI_VS_FATAL_ERROR */

    /* Flush the logs before locking the CPU */
    LOG_PANIC();

    while (true) {
    };
}
#endif /* CONFIG_BT_CTLR_ASSERT_HANDLER */

#if defined(CONFIG_BT_HCI_VS_FATAL_ERROR)
void k_sys_fatal_error_handler(unsigned int reason, const z_arch_esf_t *esf) {
    /* Disable interrupts, this is unrecoverable */
    (void)irq_lock();

    /* Generate an error event only when there is a stack frame and IPC service
     * endpoint is already bound.
     */
    if (esf != NULL && ipc_ept_ready) {
        /* Prepare vendor specific HCI debug event */
        struct net_buf *buf;

        buf = hci_vs_err_stack_frame(reason, esf);
        if (buf != NULL) {
            hci_rpmsg_send(buf, HCI_FATAL_ERR_MSG);
        } else {
            LOG_ERR("Can't create Fatal Error HCI event.\n");
        }
    }

    LOG_ERR("Halting system");

    /* Flush the logs before locking the CPU */
    LOG_PANIC();

    while (true) {
    };

    CODE_UNREACHABLE;
}
#endif /* CONFIG_BT_HCI_VS_FATAL_ERROR */

static void hci_ept_bound(void *priv) {
    k_sem_give(&ipc_bound_sem);
#if defined(CONFIG_BT_CTLR_ASSERT_HANDLER) ||                                  \
    defined(CONFIG_BT_HCI_VS_FATAL_ERROR)
    ipc_ept_ready = true;
#endif /* CONFIG_BT_CTLR_ASSERT_HANDLER || CONFIG_BT_HCI_VS_FATAL_ERROR */
}

static void hci_ept_recv(const void *data, size_t len, void *priv) {
    LOG_DBG("Received message of %u bytes.", len);
    hci_rpmsg_rx((uint8_t *)data, len);
}

static struct ipc_ept_cfg hci_ept_cfg = {
    .name = "nrf_bt_hci",
    .cb =
        {
            .bound = hci_ept_bound,
            .received = hci_ept_recv,
        },
};

int hci_rpmsg_init(void) {
    int err;
    const struct device *hci_ipc_instance = DEVICE_DT_GET(DT_NODELABEL(ipc0));

    LOG_DBG("Start");

    /* Enable the raw interface, this will in turn open the HCI driver */
    bt_enable_raw(&rx_queue);

    /* Spawn the TX thread and start feeding commands and data to the
     * controller
     */
    k_thread_create(&tx_thread_data, tx_thread_stack,
                    K_THREAD_STACK_SIZEOF(tx_thread_stack), tx_thread, NULL,
                    NULL, NULL, K_PRIO_COOP(7), 0, K_NO_WAIT);
    k_thread_name_set(&tx_thread_data, "HCI rpmsg TX");

    /* Spawn the RX thread
     */
    k_thread_create(&rx_thread_data, rx_thread_stack,
                    K_THREAD_STACK_SIZEOF(rx_thread_stack), rx_thread, NULL,
                    NULL, NULL, K_PRIO_COOP(7), 0, K_NO_WAIT);
    k_thread_name_set(&rx_thread_data, "HCI rpmsg RX");

    /* Initialize IPC service instance and register endpoint. */
    err = ipc_service_open_instance(hci_ipc_instance);
    if (err < 0 && err != -EALREADY) {
        LOG_ERR("IPC service instance initialization failed: %d\n", err);
    }

    err =
        ipc_service_register_endpoint(hci_ipc_instance, &hci_ept, &hci_ept_cfg);
    if (err) {
        LOG_ERR("Registering endpoint failed with %d", err);
    }

    return 0;
}

int hci_rpmsg_run(void) {
    k_sem_take(&ipc_bound_sem, K_FOREVER);

    while (1) {
        struct net_buf *buf;

        buf = k_fifo_get(&rx_queue, K_FOREVER);
        hci_rpmsg_send(buf, HCI_REGULAR_MSG);
        NRF_P0->OUT ^= BIT(30);
    }

    return 0;
}
```

## src/timeslot_handler.c
```c
#include "timeslot_handler.h"
#include "mdk/nrf5340_network.h"

#include <hal/nrf_timer.h>

#include <mdk/nrf.h>
#include <mpsl.h>
#include <mpsl_timeslot.h>

#include <zephyr/console/console.h>
#include <zephyr/irq.h>
#include <zephyr/kernel.h>
#include <zephyr/sys/printk.h>
#include <zephyr/sys/ring_buffer.h>
#include <zephyr/types.h>

#include <zephyr/logging/log.h>

LOG_MODULE_REGISTER(timeslot, LOG_LEVEL_INF);

#define TIMESLOT_REQUEST_TIMEOUT_US 1000000
#define TIMESLOT_LENGTH_US 10000
#define TIMESLOT_EXT_MARGIN_MARGIN 1000
#define TIMESLOT_REQ_EARLIEST_MARGIN 100
#define TIMER_EXPIRY_US_EARLY                                                  \
    (TIMESLOT_LENGTH_US - MPSL_TIMESLOT_EXTENSION_MARGIN_MIN_US -              \
     TIMESLOT_EXT_MARGIN_MARGIN)
#define TIMER_EXPIRY_REQ                                                       \
    (TIMESLOT_LENGTH_US - MPSL_TIMESLOT_EXTENSION_MARGIN_MIN_US -              \
     TIMESLOT_REQ_EARLIEST_MARGIN)

#define MPSL_THREAD_PRIO 8
#define STACKSIZE CONFIG_MAIN_STACK_SIZE

static timeslot_callback_t m_callback;
static volatile bool m_in_timeslot = false;

// Declare the RADIO IRQ handler to supress warning
void radio_irq_handler(void);

// Requests and callbacks to be run serialized from an SWI interrupt
enum mpsl_timeslot_call { OPEN_SESSION, MAKE_REQUEST, CLOSE_SESSION };

// Timeslot request
static mpsl_timeslot_request_t timeslot_request_earliest = {
    .request_type = MPSL_TIMESLOT_REQ_TYPE_EARLIEST,
    .params.earliest.hfclk = MPSL_TIMESLOT_HFCLK_CFG_NO_GUARANTEE,
    .params.earliest.priority = MPSL_TIMESLOT_PRIORITY_NORMAL,
    .params.earliest.length_us = TIMESLOT_LENGTH_US,
    .params.earliest.timeout_us = TIMESLOT_REQUEST_TIMEOUT_US};

static mpsl_timeslot_signal_return_param_t signal_callback_return_param;

// Message queue for requesting MPSL API calls to non-preemptible thread
K_MSGQ_DEFINE(mpsl_api_msgq, sizeof(enum mpsl_timeslot_call), 10, 4);

static void schedule_request(enum mpsl_timeslot_call call) {
    int err;
    enum mpsl_timeslot_call api_call = call;
    err = k_msgq_put(&mpsl_api_msgq, &api_call, K_NO_WAIT);
    if (err) {
        LOG_ERR("Message sent error: %d", err);
        k_oops();
    }
}

static void set_timeslot_active_status(bool active) {
    if (active) {
        if (!m_in_timeslot) {
            m_in_timeslot = true;
            m_callback(APP_TS_STARTED);
        }
    } else {
        if (m_in_timeslot) {
            m_in_timeslot = false;
            m_callback(APP_TS_STOPPED);
        }
    }
}

static mpsl_timeslot_signal_return_param_t *
mpsl_timeslot_callback(mpsl_timeslot_session_id_t session_id,
                       uint32_t signal_type) {
    (void)session_id; // unused parameter
    static bool timeslot_extension_failed;
    NRF_P0->OUTSET = BIT(28);
    mpsl_timeslot_signal_return_param_t *p_ret_val = NULL;
    switch (signal_type) {
    case MPSL_TIMESLOT_SIGNAL_START:
        signal_callback_return_param.callback_action =
            MPSL_TIMESLOT_SIGNAL_ACTION_NONE;
        p_ret_val = &signal_callback_return_param;

        timeslot_extension_failed = false;

        // Reset the radio to make sure no configuration remains from BLE
        NVIC_ClearPendingIRQ(RADIO_IRQn);
        NRF_RADIO->POWER = RADIO_POWER_POWER_Disabled << RADIO_POWER_POWER_Pos;
        NRF_RADIO->POWER = RADIO_POWER_POWER_Enabled << RADIO_POWER_POWER_Pos;
        NVIC_ClearPendingIRQ(RADIO_IRQn);

        nrf_timer_bit_width_set(MPSL_TIMER0, NRF_TIMER_BIT_WIDTH_32);

        nrf_timer_cc_set(MPSL_TIMER0, NRF_TIMER_CC_CHANNEL0,
                         TIMER_EXPIRY_US_EARLY);
        nrf_timer_int_enable(MPSL_TIMER0, NRF_TIMER_INT_COMPARE0_MASK);

        nrf_timer_cc_set(MPSL_TIMER0, NRF_TIMER_CC_CHANNEL1, TIMER_EXPIRY_REQ);
        nrf_timer_int_enable(MPSL_TIMER0, NRF_TIMER_INT_COMPARE1_MASK);

        set_timeslot_active_status(true);
        break;

    case MPSL_TIMESLOT_SIGNAL_TIMER0:
        if (nrf_timer_event_check(MPSL_TIMER0, NRF_TIMER_EVENT_COMPARE0)) {
            nrf_timer_int_disable(MPSL_TIMER0, NRF_TIMER_INT_COMPARE0_MASK);
            nrf_timer_event_clear(MPSL_TIMER0, NRF_TIMER_EVENT_COMPARE0);

            signal_callback_return_param.callback_action =
                MPSL_TIMESLOT_SIGNAL_ACTION_EXTEND;
            signal_callback_return_param.params.extend.length_us =
                TIMESLOT_LENGTH_US;
        } else if (nrf_timer_event_check(MPSL_TIMER0,
                                         NRF_TIMER_EVENT_COMPARE1)) {
            nrf_timer_int_disable(MPSL_TIMER0, NRF_TIMER_INT_COMPARE1_MASK);
            nrf_timer_event_clear(MPSL_TIMER0, NRF_TIMER_EVENT_COMPARE1);

            if (timeslot_extension_failed) {
                signal_callback_return_param.callback_action =
                    MPSL_TIMESLOT_SIGNAL_ACTION_REQUEST;
                signal_callback_return_param.params.request.p_next =
                    &timeslot_request_earliest;
            } else {
                signal_callback_return_param.callback_action =
                    MPSL_TIMESLOT_SIGNAL_ACTION_NONE;
            }
        }
        p_ret_val = &signal_callback_return_param;
        break;

    case MPSL_TIMESLOT_SIGNAL_EXTEND_SUCCEEDED:
        signal_callback_return_param.callback_action =
            MPSL_TIMESLOT_SIGNAL_ACTION_NONE;

        // Set next trigger time to be the current + Timer expiry early
        uint32_t current_cc =
            nrf_timer_cc_get(MPSL_TIMER0, NRF_TIMER_CC_CHANNEL0);
        nrf_timer_bit_width_set(MPSL_TIMER0, NRF_TIMER_BIT_WIDTH_32);
        nrf_timer_cc_set(MPSL_TIMER0, NRF_TIMER_CC_CHANNEL0,
                         current_cc + TIMESLOT_LENGTH_US);
        nrf_timer_int_enable(MPSL_TIMER0, NRF_TIMER_INT_COMPARE0_MASK);

        current_cc = nrf_timer_cc_get(MPSL_TIMER0, NRF_TIMER_CC_CHANNEL1);
        nrf_timer_bit_width_set(MPSL_TIMER0, NRF_TIMER_BIT_WIDTH_32);
        nrf_timer_cc_set(MPSL_TIMER0, NRF_TIMER_CC_CHANNEL1,
                         current_cc + TIMESLOT_LENGTH_US);
        nrf_timer_int_enable(MPSL_TIMER0, NRF_TIMER_INT_COMPARE1_MASK);

        p_ret_val = &signal_callback_return_param;
        break;

    case MPSL_TIMESLOT_SIGNAL_EXTEND_FAILED:
        signal_callback_return_param.callback_action =
            MPSL_TIMESLOT_SIGNAL_ACTION_NONE;
        timeslot_extension_failed = true;
        p_ret_val = &signal_callback_return_param;
        set_timeslot_active_status(false);
        break;

    case MPSL_TIMESLOT_SIGNAL_RADIO:
        signal_callback_return_param.callback_action =
            MPSL_TIMESLOT_SIGNAL_ACTION_NONE;
        p_ret_val = &signal_callback_return_param;

        // We have to manually call the RADIO IRQ handler when the RADIO signal
        // occurs
        if (m_in_timeslot) {
            radio_irq_handler();
        } else {
            NVIC_ClearPendingIRQ(RADIO_IRQn);
            NVIC_DisableIRQ(RADIO_IRQn);
        }
        break;

    case MPSL_TIMESLOT_SIGNAL_OVERSTAYED:
        LOG_WRN("something overstayed!");
        signal_callback_return_param.callback_action =
            MPSL_TIMESLOT_SIGNAL_ACTION_END;
        p_ret_val = &signal_callback_return_param;
        set_timeslot_active_status(false);
        break;

    case MPSL_TIMESLOT_SIGNAL_CANCELLED:
        LOG_DBG("something cancelled!");
        signal_callback_return_param.callback_action =
            MPSL_TIMESLOT_SIGNAL_ACTION_NONE;
        p_ret_val = &signal_callback_return_param;
        set_timeslot_active_status(false);

        // In this case returning SIGNAL_ACTION_REQUEST causes hardfault. We
        // have to request a new timeslot instead, from thread context.
        schedule_request(MAKE_REQUEST);
        break;

    case MPSL_TIMESLOT_SIGNAL_BLOCKED:
        LOG_INF("something blocked!");
        signal_callback_return_param.callback_action =
            MPSL_TIMESLOT_SIGNAL_ACTION_NONE;
        p_ret_val = &signal_callback_return_param;
        set_timeslot_active_status(false);

        // Request a new timeslot in this case
        schedule_request(MAKE_REQUEST);
        break;

    case MPSL_TIMESLOT_SIGNAL_INVALID_RETURN:
        LOG_WRN("something gave invalid return");
        signal_callback_return_param.callback_action =
            MPSL_TIMESLOT_SIGNAL_ACTION_END;
        p_ret_val = &signal_callback_return_param;
        set_timeslot_active_status(false);
        break;

    case MPSL_TIMESLOT_SIGNAL_SESSION_IDLE:
        LOG_INF("idle");

        // Request a new timeslot in this case
        schedule_request(MAKE_REQUEST);

        signal_callback_return_param.callback_action =
            MPSL_TIMESLOT_SIGNAL_ACTION_NONE;
        p_ret_val = &signal_callback_return_param;
        set_timeslot_active_status(false);
        break;

    case MPSL_TIMESLOT_SIGNAL_SESSION_CLOSED:
        LOG_INF("Session closed");

        signal_callback_return_param.callback_action =
            MPSL_TIMESLOT_SIGNAL_ACTION_NONE;
        p_ret_val = &signal_callback_return_param;
        set_timeslot_active_status(false);
        break;

    default:
        LOG_ERR("unexpected signal: %u", signal_type);
        k_oops();
        break;
    }
    NRF_P0->OUTCLR = BIT(28);
    return p_ret_val;
}

static void mpsl_nonpreemptible_thread(void) {
    int err;
    enum mpsl_timeslot_call api_call = 0;

    /* Initialize to invalid session id */
    mpsl_timeslot_session_id_t session_id = 0xFFu;

    while (1) {
        if (k_msgq_get(&mpsl_api_msgq, &api_call, K_FOREVER) == 0) {
            switch (api_call) {
            case OPEN_SESSION:
                err = mpsl_timeslot_session_open(mpsl_timeslot_callback,
                                                 &session_id);
                if (err) {
                    LOG_ERR("Timeslot session open error: %d", err);
                    k_oops();
                }
                break;
            case MAKE_REQUEST:
                err = mpsl_timeslot_request(session_id,
                                            &timeslot_request_earliest);
                if (err) {
                    LOG_ERR("Timeslot request error: %d", err);
                    k_oops();
                }
                break;
            case CLOSE_SESSION:
                err = mpsl_timeslot_session_close(session_id);
                if (err) {
                    LOG_ERR("Timeslot session close error: %d", err);
                    k_oops();
                }
                break;
            default:
                LOG_ERR("Wrong timeslot API call");
                k_oops();
                break;
            }
        }
    }
}

void timeslot_handler_init(timeslot_callback_t callback) {
    m_callback = callback;

    schedule_request(OPEN_SESSION);

    schedule_request(MAKE_REQUEST);
}

K_THREAD_DEFINE(mpsl_nonpreemptible_thread_id, STACKSIZE,
                mpsl_nonpreemptible_thread, NULL, NULL, NULL,
                K_PRIO_COOP(MPSL_THREAD_PRIO), 0, 0);
```
