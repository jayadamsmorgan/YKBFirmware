## lib/ykb_esb/Kconfig
```kconfig
menuconfig LIB_YKB_ESB
    bool "Enable YKB ESB library"
    default n
    depends on SOC_SERIES_NRF53X || SOC_SERIES_NRF52X
    select LIB_YKB_ESB_IMPL

if LIB_YKB_ESB

    module = YKB_ESB
    module-str = ykb_esb
    source "subsys/logging/Kconfig.template.log_config"

    config ESB_MAX_PAYLOAD_LENGTH
        default 252 # Maxxing

    config LIB_YKB_ESB_FAST_RAMP_UP
        bool "Enable ESB Fast Ramp Up"
        depends on !SOC_NRF5340_CPUAPP
        default n
        help
          When this feature is enabled, radio TXEN and RXEN delays are reduced from 130 µs to 40 µs.
          The radio peripheral needs some time to start up analog components of the radio.
          On the nRF51 and nRF24L Series devices, a hard-coded 130 µs delay is implemented.
          If ESB connection is achieved only between nRF52 and/or nRF53 Series devices, this delay can be reduced to 40 µs.

    config LIB_YKB_ESB_MPSL
        bool "Enable support for using with YKB Timeslot library"
        depends on !SOC_NRF5340_CPUAPP
        default y if BT
        select LIB_YKB_TIMESLOT

    config LIB_YKB_ESB_IMPL
        bool
        select LIB_YKB_ESB_IMPL_NORMAL if SOC_SERIES_NRF52X
        select LIB_YKB_ESB_IMPL_NRF53 if SOC_SERIES_NRF53X
        select RING_BUFFER
        select DYNAMIC_INTERRUPTS
        select DYNAMIC_DIRECT_INTERRUPTS

    config LIB_YKB_ESB_IMPL_NRF53
        bool
        select IPC_SERVICE
        select MBOX
        select NRF_RPC
        select NRF_RPC_CBOR
        select THREAD_CUSTOM_DATA
        select LIB_YKB_ESB_IMPL_NORMAL if SOC_NRF5340_CPUNET
        select LIB_YKB_ESB_IMPL_NRF53_APP if SOC_NRF5340_CPUAPP

    config LIB_YKB_ESB_IMPL_NORMAL
        bool
        select ESB
        select ESB_DYNAMIC_INTERRUPTS
        select MPSL

    config LIB_YKB_ESB_IMPL_NRF53_APP
        bool
        select SOC_NRF53_CPUNET_ENABLE

endif # LIB_YKB_ESB
```

## lib/ykb_timeslot/Kconfig
```kconfig
menuconfig LIB_YKB_TIMESLOT
    bool "Enable YKB timeslot library for concurrent BT + ESB"
    depends on SOC_SERIES_NRF52X || SOC_NRF5340_CPUNET

if LIB_YKB_TIMESLOT

    module = YKB_TIMESLOT
    module-str = ykb_timeslot
    source "subsys/logging/Kconfig.template.log_config"

endif # LIB_YKB_TIMESLOT
```

## subsys/Kconfig
```kconfig
menu "YKB Subsystems"

    rsource "bt_connect/Kconfig"
    rsource "kb_settings/Kconfig"
    rsource "ykb_battsense/Kconfig"
    rsource "usb_connect/Kconfig"
    rsource "kb_handler/Kconfig"
    rsource "ykb_backlight/Kconfig"

endmenu
```

## subsys/kb_handler/Kconfig.splitlink
```kconfig
if KB_HANDLER_SPLITLINK

    choice KB_HANDLER_SPLITLINK_HANDLER_IMPL
        prompt "Splitlink driver handler"
        
        config KB_HANDLER_SPLITLINK_HANDLER_IMPL_YKB_PROTO
            bool "Splitlink driver handler over YKB protocol"

    endchoice

    if KB_HANDLER_SPLITLINK_HANDLER_IMPL_YKB_PROTO

        config KB_HANDLER_SL_OUT_OF_ORDER_TRACK
            bool "Enable out-of-order feature of YKB protocol"
            default n

        config KB_HANDLER_SL_BITMAP_LENGTH
            bool "Bitmap length for out-of-order feature"
            depends on KB_HANDLER_SL_OUT_OF_ORDER_TRACK
            default 32

    endif # KB_HANDLER_SPLITLINK_HANDLER_IMPL_YKB_PROTO

endif # KB_HANDLER_SPLITLINK
```

## subsys/kb_settings/Kconfig
```kconfig
menuconfig KB_SETTINGS
    bool "Enable KB Settings library"
    depends on KB_HANDLER
    select SETTINGS

if KB_SETTINGS

    module = KB_SETTINGS
    module-str = kb_settings
    source "subsys/logging/Kconfig.template.log_config"

    ZEPHYR_USER := zephyr,user
    KB_HANDLER_PATH := $(dt_nodelabel_path,kb_handler)

    config KB_SETTINGS_KEY_COUNT
        int
        default $(dt_node_int_prop_int,/$(ZEPHYR_USER),kb-handler-key-count)

    config KB_SETTINGS_KEY_COUNT_SLAVE
        int
        depends on $(dt_node_has_prop,/$(ZEPHYR_USER),kb-handler-key-count-slave)
        default $(dt_node_int_prop_int,/$(ZEPHYR_USER),kb-handler-key-count-slave)

    config KB_SETTINGS_INIT_PRIORITY
        int "Init priority"
        default 140

    if YKB_BACKLIGHT

        config KB_SETTINGS_YKB_BL_SCRIPT_STORAGE_LEN
            int "Amount of storage (in bytes) reserved for Lumiscript backlight scripts available in KB Settings"
            default 4096

        config KB_SETTINGS_YKB_BL_SCRIPT_NAME_MAX_LEN
            int "Maximum amount of characters for a Lumiscript backlight script name"
            default 15

    endif # YKB_BACKLIGHT

endif # KB_SETTINGS
```

## west.yml
```yaml
manifest:
  self:
    west-commands: west-commands.yml

  remotes:
    - name: ncs
      url-base: https://github.com/YarmanKB

  projects:
    - name: nrf
      remote: ncs
      repo-path: sdk-nrf
      revision: v3.2.1-patch-nrf5340-mpsl
      import: true

    - name: lumiscript
      path: modules/lumiscript
      revision: master
      url: https://github.com/YarmanKB/lumiscript
```

## ykb-config/Kconfig
```kconfig
menu "YKBFirmware settings"

config YKB_SPLIT_KB
    bool

if YKB_SPLIT_KB
rsource "Kconfig.split"
endif # YKB_SPLIT_KB

if !YKB_SPLIT_KB
rsource "Kconfig.regular"
endif # !YKB_SPLIT_KB

config YKB_KB_KEY_COUNT
    int

endmenu # YKBFirmware settings
```

## ykb-config/Kconfig.split
```kconfig
config YKB_IS_SPLIT_MASTER
    bool

config YKB

choice YKB_SPLIT_MASTER
    prompt "Master half of the YKB keyboard"
    default YKB_SPLIT_MASTER_LEFT
    select YKB_IS_SPLIT_MASTER if 

config YKB_SPLIT_MASTER_LEFT
    bool "Use left keyboard as master"

config YKB_SPLIT_MASTER_RIGHT
    bool "Use right keyboard as master"

endchoice # YKB_MASTER_HALF
```
