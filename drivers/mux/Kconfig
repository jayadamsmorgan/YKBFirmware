## lib/Kconfig
```kconfig
menu "YKB Libraries"

    rsource "ykb_esb/Kconfig"
    rsource "ykb_timeslot/Kconfig"

endmenu
```

## lib/bt_connect/Kconfig
```kconfig
config LIB_BT_CONNECT
    bool "Enable BT Connect library"
    select BT
    select BT_SMP
    select BT_PERIPHERAL
    select BT_BAS
    select BT_HIDS
    select BT_CONN_CTX
    select BT_DIS
    select BT_DIS_MANUF_NAME
    select BT_DIS_PNP
    select SETTINGS
    select BT_SETTINGS

if LIB_BT_CONNECT

    module = BT_CONNECT
    module-str = bt_connect
    source "subsys/logging/Kconfig.template.log_config"

    configdefault BT_ATT_TX_COUNT
        default 5

    configdefault BT_GATT_AUTO_SEC_REQ
        default n

    configdefault BT_AUTO_PHY_UPDATE
        default n

    configdefault BT_DEVICE_APPEARANCE
        default 961

    configdefault BT_GATT_UUID16_POOL_SIZE
        default 40

    configdefault BT_GATT_CHRC_POOL_SIZE
        default 20

    configdefault BT_DIS_MANUF_NAME_STR
        default "YarmanKB"

    configdefault BT_DIS_PNP_VID_SRC
        default 2

    configdefault BT_DIS_PNP_VID
        default 0x6969
    
endif # LIB_BT_CONNECT
```

## lib/esb_ble_mpsl/Kconfig
```kconfig
config LIB_ESB_BLE_MPSL
    bool "ESB + BLE MPSL Timeslot library"
    select MPSL
    select RING_BUFFER
    select DYNAMIC_INTERRUPTS
    select DYNAMIC_DIRECT_INTERRUPTS
    select ESB_DYNAMIC_INTERRUPTS
    select MBOX
```

## lib/kb_settings/Kconfig
```kconfig
menuconfig LIB_KB_SETTINGS
    bool "Enable KB Settings library"
    depends on KB_HANDLER
    default y
    select SETTINGS

if LIB_KB_SETTINGS

    module = KB_SETTINGS
    module-str = kb_settings
    source "subsys/logging/Kconfig.template.log_config"

    KB_HANDLER_PATH := $(dt_nodelabel_path,kb_handler)

    config KB_SETTINGS_KEY_COUNT
        int
        default $(dt_node_int_prop_int,$(KB_HANDLER_PATH),key-count)

    config KB_SETTINGS_KEY_COUNT_SLAVE
        int
        depends on $(dt_node_has_prop,$(KB_HANDLER_PATH),key-count-slave)
        default $(dt_node_int_prop_int,$(KB_HANDLER_PATH),key-count-slave)

endif # LIB_KB_SETTINGS
```

## lib/usb_connect/Kconfig
```kconfig
menuconfig LIB_USB_CONNECT
    bool "Enable USB Connect library"
    default y if KB_HANDLER && DT_HAS_ZEPHYR_HID_DEVICE_ENABLED
    select HWINFO
    select USB_DEVICE_STACK_NEXT
    select USBD_HID_SUPPORT

if LIB_USB_CONNECT

    module = USB_CONNECT
    module-str = usb_connect
    source "subsys/logging/Kconfig.template.log_config"

    config LIB_USB_CONNECT_SELF_POWERED
        bool "Enable USB device Self-powered attribute"
        default y

    config LIB_USB_CONNECT_REMOTE_WAKEUP
        bool "Enable remote wakeup feature"
        default y

    config LIB_USB_CONNECT_VID
        hex "USB device vendor ID"
        default 0x6969
    
    config LIB_USB_CONNECT_PID
        hex "USB device product ID"

    config LIB_USB_CONNECT_MANUFACTURER
        string "USB device manufacturer string"
        default "YarmanKB"

    config LIB_USB_CONNECT_PRODUCT
        string "USB device product string"

    config LIB_USB_CONNECT_MAX_POWER
        int "USB Max Power value"
        range 1 250
        default 250

    config LIB_USB_CONNECT_20_EXTENSION_DESC
        bool "Enable USB2.0 Extension descriptor"

    config LIB_USB_CONNECT_INIT_PRIORITY
        int "Init priority"
        default APPLICATION_INIT_PRIORITY

    HID_DEV_PATH := $(dt_nodelabel_path,hid_vendor)

    config LIB_USB_CONNECT_MAX_VENDOR_IN_REPORT_SIZE
        int "In report packet size of vendor HID"
        range 7 $(dt_node_int_prop_int,$(HID_DEV_PATH),in-report-size)
        default $(dt_node_int_prop_int,$(HID_DEV_PATH),in-report-size)

    config LIB_USB_CONNECT_MAX_VENDOR_OUT_REPORT_SIZE
        int "Out report packet size of vendor HID"
        range 7 $(dt_node_int_prop_int,$(HID_DEV_PATH),out-report-size)
        default $(dt_node_int_prop_int,$(HID_DEV_PATH),out-report-size)

    config LIB_USB_CONNECT_VENDOR_THREAD_PRIORITY
        int "Vendor thread priority"
        default 15

    config LIB_USB_CONNECT_VENDOR_THREAD_STACK_SIZE
        int "Vendor thread stack size"
        default 1024

    config LIB_USB_CONNECT_VENDOR_MSGQ_SIZE
        int "Vendor thread ring buffer size"
        default 8

endif # LIB_USB_CONNECT
```

## lib/ykb_backlight/Kconfig
```kconfig
ZEPHYR_USER := zephyr,user

menuconfig YKB_BACKLIGHT
    bool "Enable backlight for LED strip based backlight"
	depends on $(dt_node_has_prop,/$(ZEPHYR_USER),ykb-backlight)
	depends on $(dt_node_has_prop,/$(ZEPHYR_USER),ykb-backlight-maps)
    depends on $(dt_node_has_prop,/$(ZEPHYR_USER),ykb-backlight-xs)
    depends on $(dt_node_has_prop,/$(ZEPHYR_USER),ykb-backlight-ys)
    select LED_STRIP
    select LUMISCRIPT
    default y

if YKB_BACKLIGHT

    module = YKB_BACKLIGHT
    module-str = ykb_backlight
    source "subsys/logging/Kconfig.template.log_config"

    config YKB_BL_THREAD_STACK_SIZE
        int "Thread stack size"
        default 80000

    config YKB_BL_THREAD_PRIORITY
        int "Thread priority"
        default 15

    config YKB_BL_INIT_PRIORITY
        int "Init priority"
        default APPLICATION_INIT_PRIORITY

    menu "Lumiscript VM"

        config YKB_BL_MAX_SCRIPTS
            int "Maximum amount of scripts stored in settings"
            depends on LIB_KB_SETTINGS
            default 10

        config YKB_BL_LUMIVM_CONST_CAPACITY
            int "Lumiscript VM max amount of constants"
            default 512

        config YKB_BL_LUMIVM_GLOBAL_CAPACITY
            int "Lumiscript VM max amount of global variables"
            default 256

        config YKB_BL_LUMIVM_KEY_VAR_CAPACITY
            int "Lumiscript VM max amount of key variables"
            default 128

        config YKB_BL_LUMIVM_CODE_CAPACITY
            int "Lumiscript VM max size of the bytecode script"
            default 8192

        config YKB_BL_LUMIVM_STACK_CAPACITY
            int "Lumiscript VM max amount of stack objects"
            default 256

    endmenu

endif # YKB_BACKLIGHT
```
