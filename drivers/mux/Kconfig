## drivers/mux/Kconfig
```kconfig
menuconfig MUX
	bool "Multiplexer device drivers"
	help
	  This option enables the custom driver class for generic MUXes.

if MUX

    module = MUX
    module-str = mux
    source "subsys/logging/Kconfig.template.log_config"

    rsource "Kconfig.gpio"

endif # MUX
```

## drivers/mux/Kconfig.gpio
```kconfig
config MUX_GPIO
	bool "GPIO-controlled generic multiplexer driver"
	default y if DT_HAS_MUX_GPIO_ENABLED
	select GPIO
	help
	  Enable this option to use the GPIO-controlled multiplexer driver.

if MUX_GPIO

    config MUX_GPIO_MAX_SEL_CNT
        int "Maximum amount of select lines"
        default 8
        help
          Maximum amount of select lines (pins) driver supports.

endif # MUX_GPIO
```

## drivers/splitlink/Kconfig
```kconfig
menuconfig SPLITLINK
    bool "Enable Splitlink"
    default y

if SPLITLINK

    module = SPLITLINK
    module-str = splitlink
    source "subsys/logging/Kconfig.template.log_config"

    rsource "Kconfig.ykb_esb"

endif # SPLITLINK
```

## drivers/splitlink/Kconfig.ykb_esb
```kconfig
config SPLITLINK_YKB_ESB
    bool "Enable Splitlink over ESB"
    default y if (DT_HAS_SPLITLINK_YKB_ESB_PTX_ENABLED || DT_HAS_SPLITLINK_YKB_ESB_PRX_ENABLED)
    select LIB_YKB_ESB

if SPLITLINK_YKB_ESB

    choice SPLITLINK_YKB_ESB_ROLE
        prompt "Splitlink over ESB role"
        default SPLITLINK_YKB_ESB_PTX if DT_HAS_SPLITLINK_YKB_ESB_PTX_ENABLED
        default SPLITLINK_YKB_ESB_PRX if DT_HAS_SPLITLINK_YKB_ESB_PRX_ENABLED

        config SPLITLINK_YKB_ESB_PTX
            bool "Enable Splitlink over ESB as PTX"

        config SPLITLINK_YKB_ESB_PRX
            bool "Enable Splitlink over ESB as PRX"

    endchoice # SPLITLINK_YKB_ESB_ROLE

    config SPLITLINK_YKB_ESB_MAX_PACKETS
        int "Maximum amount of packets allowed to be sent/received"
        default 30

    config SPLITLINK_YKB_ESB_ALIVE_TIMEOUT
        int "Time after last incoming packet after which disconnect is triggered (ms)"
        default 200
        range 2 1000

    config SPLITLINK_YKB_ESB_MAX_ACTIVE_STREAMS
        int "Max amount of concurrent streams"
        default 3
        range 1 10

    if SPLITLINK_YKB_ESB_PTX

        config SPLITLINK_YKB_ESB_PTX_ALIVE_THREAD_STACK_SIZE
            int "'Alive' PTX thread stack size"
            default 1024

        config SPLITLINK_YKB_ESB_PTX_ALIVE_THREAD_PRIORITY
            int "'Alive' PTX thread priority"
            default 5

        config SPLITLINK_YKB_ESB_PTX_ALIVE_THREAD_TIME
            int "Time between 'Alive' packets (ms)"
            default 50
            range 1 SPLITLINK_YKB_ESB_ALIVE_TIMEOUT

    endif # SPLITLINK_YKB_ESB_PTX

endif # SPLITLINK_YKB_ESB
```

## dts/bindings/charger/ti,bq25185.yaml
```yaml
description: >
  Texas Instruments BQ25185 standalone Li-Ion battery charger.
  This charger does not use a control bus (I2C/SPI). Charging status
  is exposed via STAT1 and STAT2 pins. Optional CE pin can be used
  to enable/disable charging.

compatible: "ti,bq25185"

include: base.yaml

properties:
  stat1-gpios:
    type: phandle-array
    required: true
    description: |
      GPIO connected to STAT1 pin (open-drain output).
      Indicates charger status. Typically active low.

  stat2-gpios:
    type: phandle-array
    required: true
    description: |
      GPIO connected to STAT2 pin (open-drain output).
      Used together with STAT1 to determine charger state.

  vin-present-gpios:
    type: phandle-array
    required: false
    description: |
      Optional pin signaling that VIN is present on BQ25185.
      Not present on the IC itself, but it is useful since it is ambigious
      to tell wether battery is fully charged or not charging at the moment
      just from STAT1/STAT2 pins.

  ce-gpios:
    type: phandle-array
    required: false
    description: |
      GPIO connected to CE (Charge Enable) pin.
      Active level depends on board design (usually active low).
      If not present assuming that BQ25185's CE pin is always low.

  label:
    type: string
    required: false

  status:
    type: string
    required: false
```

## dts/bindings/charger/ykb,simple-charger.yaml
```yaml
description: >
  Binding for a simple generic charger emulation.

compatible: "ykb,simple-charger"

include: base.yaml

properties:
  vin-present-gpios:
    type: phandle-array
    required: true
    description: |
      GPIO which indicates that charging is in progress.

  ce-gpios:
    type: phandle-array
    required: false
    description: |
      Optional GPIO which controls the charging of the device

  charge-complete-gpios:
    type: phandle-array
    required: false
    description: |
      Optional GPIO which indicates that charging is complete.
```

## dts/bindings/kb_handler/kb-handler-simple.yaml
```yaml
title: KBHandler for simple KB device

description: >
  KBHandler driver binding for simple KB device.
  This device will act as a keyboard, collecting keys from itself and
  processing them and then communicating with host (BT/USB).

compatible: "kb-handler-simple"

include: kb-handler.yaml
```

## dts/bindings/kb_handler/kb-handler-splitlink-master.yaml
```yaml
title: KBHandler for Splitlink master device

description: >
  KBHandler driver binding for the Splitlink "master" device.
  This device will act as a main keyboard, collecting keys from itself and "slave" device if it's connected,
  processing them and then communicating with host (BT/USB).

compatible: "kb-handler-splitlink-master"

include: kb-handler.yaml

properties:
  key-count-slave:
    type: int
    required: true
    description: Amount of keys for the "slave" device (other half).
```

## dts/bindings/kb_handler/kb-handler-splitlink-slave.yaml
```yaml
title: KBHandler for Splitlink slave device

description: >
  KBHandler driver binding for the Splitlink "slave" device.
  This device will act as a secondary keyboard, collecting keys from itself
  and send them to the Splitlink "master" device.

compatible: "kb-handler-splitlink-slave"

include: kb-handler.yaml
```

## dts/bindings/kb_handler/kb-handler-splitlink.yaml
```yaml
# Common fields for KB Handler Splitlink driver

include: kb-handler.yaml

properties:
  splitlink:
    type: phandle
    required: true
    description: Splitlink driver phandle
```

## dts/bindings/kb_handler/kb-handler.yaml
```yaml
# Common fields for KB Handler driver

include: base.yaml

properties:
  kscans:
    type: phandle-array
    required: true
    description: >
      KScan instances for the KB Handler to manage.

  key-count:
    type: int
    required: true
    description: >
      Amount of keys for current keyboard.
      For split keyboards this is the amount of keys for the current half.

  mouseemu-enabled:
    type: boolean
    required: false
    description: >
      Enables mouse emulation support for this keyboard handler instance.

  mouseemu-direction-mode:
    type: string
    required: false
    enum:
      - "4-way"
      - "8-way"
    description: >
      Mouse movement directional mode.
      Selects whether movement keys are interpreted as 4-directional or
      8-directional input.

  mouseemu-move-keys:
    type: array
    required: false
    description: >
      Key indices used for pointer movement.
      For 4-direction mode provide [left, up, down, right].
      For 8-direction mode provide
      [left, up, down, right, up_left, up_right, down_left, down_right].

  mouseemu-move-keys-deadzones:
    type: array
    required: false
    description: >
      10 bit threshold values for the mouse emulation move keys.
      Should map 1:1 to mouseemu-move-keys.

  mouseemu-move-x-k-mul:
    type: int
    required: false
    description:
      Multiplier for the final value for moving cursor (X axis).

  mouseemu-move-x-k-div:
    type: int
    required: false
    description:
      Divider for the final value for moving cursor (X axis).

  mouseemu-move-y-k-mul:
    type: int
    required: false
    description:
      Multiplier for the final value for moving cursor (Y axis).

  mouseemu-move-y-k-div:
    type: int
    required: false
    description:
      Divider for the final value for moving cursor (Y axis).

  mouseemu-scroll-k-mul:
    type: int
    required: false
    description:
      Multiplier for the final value for scrolling (Y axis).

  mouseemu-scroll-k-div:
    type: int
    required: false
    description:
      Divider for the final value for scrolling (Y axis).

  mouseemu-scroll-keys:
    type: array
    required: false
    description: >
      Key indices used for mouse wheel scrolling.
      Expected order is [scroll_up, scroll_down].

  mouseemu-scroll-keys-deadzones:
    type: array
    required: false
    description: >
      10 bit threshold values for the mouse emulation scroll keys.
      Should map 1:1 to mouseemu-scroll-keys.

  mouseemu-button-keys:
    type: array
    required: false
    description: >
      Key indices used for mouse button emulation.
      Expected order is [left_button, right_button, middle_button].

  default-keymap-layer1:
    type: array
    required: true
    description: >
      Default key mappings used (layer 1).
      Each key index reported from KScan instances will be handled with this mapping.
      So match indexes from them to handle properly.
      For regular keyboards should be the same length as key-count.
      For split keyboards should be the same length as key-count + slave-key-count.

  default-keymap-layer2:
    type: array
    required: false
    description: >
      Default key mappings used (layer 2).
      Each key index reported from KScan instances will be handled with this mapping.
      So match indexes from them to handle properly.
      For regular keyboards should be the same length as key-count.
      For split keyboards should be the same length as key-count + slave-key-count.

  default-keymap-layer3:
    type: array
    required: false
    description: >
      Default key mappings used (layer 3).
      Each key index reported from KScan instances will be handled with this mapping.
      So match indexes from them to handle properly.
      For regular keyboards should be the same length as key-count.
      For split keyboards should be the same length as key-count + slave-key-count.
```

## dts/bindings/kscan/kscan-channels.yaml
```yaml
title: KScan Channels Instance

description: >
  A binding for a KScan instance which is polling hall effect sensors where
  each sensor has a dedicated ADC channel.

compatible: "kscan-channels"

include: kscan.yaml

properties:

  io-channels:
    type: phandle-array
    required: true
    description: ADC channels used.

  enable-gpios:
    type: phandle-array
    required: false
    description: >
      Optional enable pins for hall sensors.
      Can save a bit of power if provided at a cost of polling performance.
      Should be the same amount and in the same order as corresponding ADC channels.
```

## dts/bindings/kscan/kscan-enables.yaml
```yaml
title: KScan Enables Instances

description: >
  A binding for a KScan instance which is polling hall effect sensors where
  each sensor has an enable pin and a common ADC channel.

compatible: "kscan-enables"

include: kscan.yaml

properties:

  io-channel:
    type: phandle-array
    required: true
    description: ADC channel used.

  enable-gpios:
    type: phandle-array
    required: false
    description: >
      Optional enable pins for hall sensors.
      Can save a bit of power if provided at a cost of polling performance.
      Should be the same amount and in the same order as corresponding ADC channels.
```

## dts/bindings/kscan/kscan-muxes.yaml
```yaml
title: KScan Muxes Instance

description: >
  A binding for a KScan instance which is polling hall effect sensors
  by multiplexing either ADC channels or enable pins.
  So the board configuration could be either:
    - Hall effect sensors connected to the MUXes with ADC channels
      and each MUX common pin acts as input for the ADC channel on the MCU.
    - Hall effect sensors connected to the MUXes with enable pins
      and each MUX common pin serves as output for selecting active sensor.
  The second configuration requires 1 more pin on the MCU for the ADC channel (per MUX)
  but it significantly reduces the power consuption, since only one sensor is active at a time (per MUX).
  The more ADC channels (and, of course, corresponding MUXes) you have the more performance you can get
  since you can read another channel while the other one is waiting settle-time.

compatible: "kscan-muxes"

include: kscan.yaml

properties:
  io-channels:
    type: phandle-array
    required: true
    description: ADC channels used for each multiplexor. Should be equal to the amount of muxes.

  muxes:
    type: phandle-array
    required: true
    specifier-space: mux
    description: MUXes used. Should be equal to the amount of io-channels and in the same order as corresponding io-channels.
```

## dts/bindings/kscan/kscan.yaml
```yaml
# Common fields for KScan instances

include: base.yaml

properties:
  idx-offset:
    type: int
    required: true
    description: Index offset for reporting pressed/released keys. Should be >= 0.

  settle-us:
    type: int
    required: true
    description: >
      The amount of wait time (microseconds) needed between MUX channel switching.
      This KScan instance will create a thread for each of the ADC channel and pass settle-time to the k_usleep() if not 0. Should be > 0.
```

## dts/bindings/mux/mux-gpio.yaml
```yaml
title: GPIO-Select Multiplexer

description: >
  Generic channel multiplexer controlled by a set of select GPIOs (and optional
  enable GPIO). Channels are addressed by an integer index; the mapping from
  index to select lines is binary unless channel-map is provided.

compatible: "mux-gpio"

include: base.yaml

properties:
  sel-gpios:
    type: phandle-array
    required: true
    description: Select GPIOs, LSB first (idx 0 is bit0).

  enable-gpios:
    type: phandle-array
    required: false
    description: Optional enable/enable-bar pin.

  channels:
    type: int
    required: false
    description: >
      Number of valid channels. If omitted, defaults to (2 ^ len(sel-gpios)).

  settle-us:
    type: int
    required: false
    description: Delay (microseconds) to wait after switching before use. If omitted, defaults to 0.

  idle-channel:
    type: int
    required: false
    description: >
      Channel to select on initialization and disable event. If omitted, channel 0 is selected at init
      and driver leaves last selected channel between disable/enable events.

  channel-map:
    type: array
    required: false
    description: >
      Optional LUT: physical channel order -> binary code (one u32 per channel).
      If present, should be the length of 'channels'. Values are the raw bit pattern
      to drive on sel-gpios (LSB=idx 0).
      Initialization will select the first channel in this order automatically unless idle-channel is present.
      If both channel-map and idle-channel are omitted, initialization will select physical channel 0.
```

## dts/bindings/splitlink/splitlink-ykb-esb-prx.yaml
```yaml
title: Splitlink over YKB ESB driver (PRX role)

description: >
  A binding for Splitlink connection using YKB ESB library (PRX receiving role). 

compatible: "splitlink-ykb-esb-prx"

include: splitlink-ykb-esb.yaml
```

## dts/bindings/splitlink/splitlink-ykb-esb-ptx.yaml
```yaml
title: Splitlink over YKB ESB driver (PTX role)

description: >
  A binding for Splitlink connection using YKB ESB library (PTX transmitting role).

compatible: "splitlink-ykb-esb-ptx"

include: splitlink-ykb-esb.yaml
```

## dts/bindings/splitlink/splitlink-ykb-esb.yaml
```yaml
include: base.yaml

properties:

  esb-default-address:
    type: uint8-array
    required: true
    description: >
      Default address to initiate first connection with between ESB PTX/PRX devices.
```
