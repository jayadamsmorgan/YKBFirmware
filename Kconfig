## Kconfig.ykb/Kconfig
```kconfig
menu "YKBFirmware settings"

config YKB_SPLIT
    bool "Compile for the split keyboard"

if YKB_SPLIT
rsource "Kconfig.split"
endif # YKB_SPLIT_KB

if !YKB_SPLIT
rsource "Kconfig.regular"
endif # !YKB_SPLIT_KB

endmenu # YKBFirmware settings
```

## Kconfig.ykb/Kconfig.split
```kconfig
config YKB_SPLIT_LEFT
    bool "Compile for the left board"

config YKB_SPLIT_KEY_COUNT_LEFT
    int "Amount of keys for the left board"

config YKB_SPLIT_RIGHT
    bool "Compile for the right board"

config YKB_SPLIT_KEY_COUNT_RIGHT
    int "Amount of keys for the right board"

config YKB_SPLIT_IS_MASTER
    bool

choice YKB_SPLIT_MASTER_BOARD
    prompt "Master half of the YKB keyboard"
    default YKB_SPLIT_MASTER_LEFT

config YKB_SPLIT_MASTER_LEFT
    bool "Use left keyboard as master"
    select YKB_SPLIT_IS_MASTER if YKB_SPLIT_LEFT

config YKB_SPLIT_MASTER_RIGHT
    bool "Use right keyboard as master"
    select YKB_SPLIT_IS_MASTER if YKB_SPLIT_RIGHT

endchoice # YKB_MASTER_HALF
```

## boards/ykb/dactyl_v1/Kconfig.dactyl_v1
```kconfig
config BOARD_DACTYL_V1
    select SOC_NRF5340_CPUAPP_QKAA if BOARD_DACTYL_V1_NRF5340_CPUAPP
	select SOC_NRF5340_CPUAPP_QKAA if BOARD_DACTYL_V1_NRF5340_CPUAPP_LEFT
    select SOC_NRF5340_CPUAPP_QKAA if BOARD_DACTYL_V1_NRF5340_CPUAPP_RIGHT
	select SOC_NRF5340_CPUNET_QKAA if BOARD_DACTYL_V1_NRF5340_CPUNET
```

## boards/ykb/dactyl_v1/Kconfig.defconfig
```kconfig
if BOARD_DACTYL_V1_NRF5340_CPUAPP_LEFT || BOARD_DACTYL_V1_NRF5340_CPUAPP_RIGHT

    DT_CHOSEN_Z_CODE_PARTITION := zephyr,code-partition
    DT_CHOSEN_Z_SRAM_PARTITION := zephyr,sram-secure-partition

    if USB_DEVICE_STACK

        config USB_DEVICE_VID
            default 0x6969

        config USB_DEVICE_PID
            default 0x0001

    endif # USB_DEVICE_STACK

    if KB_HANDLER

        choice KB_HANDLER_IMPL
            default KB_HANDLER_SPLITLINK_MASTER if BOARD_DACTYL_V1_NRF5340_CPUAPP_LEFT
            default KB_HANDLER_SPLITLINK_SLAVE if BOARD_DACTYL_V1_NRF5340_CPUAPP_RIGHT
            endchoice

    endif # KB_HANDLER

    if USB_CONNECT

        config USB_CONNECT_PID
            default 0x0001

        config USB_CONNECT_PRODUCT
            default "Dactyl V1"

        config USB_CONNECT_MAX_POWER
            default 250

    endif # USB_CONNECT

    if BT_CONNECT

        config BT_MAX_CONN
            default 1

        config BT_HIDS_MAX_CLIENT_COUNT
            default 1

        config BT_MAX_PAIRED
            default 2

        config BT_DEVICE_NAME
            default "Dactyl V1"

        config BT_DIS_PNP_PID
            default 0x0001

        config BT_DIS_PNP_VER
            default 0x0001

    endif # BT_CONNECT

    if BOARD_DACTYL_V1_NRF5340_CPUAPP && TRUSTED_EXECUTION_SECURE

        config FLASH_LOAD_SIZE
            default $(dt_chosen_reg_size_hex,$(DT_CHOSEN_Z_CODE_PARTITION))

        config SRAM_SIZE
            default $(dt_chosen_reg_size_int,$(DT_CHOSEN_Z_SRAM_PARTITION),0,K)

    endif # BOARD_DACTYL_V1_NRF5340_CPUAPP && TRUSTED_EXECUTION_SECURE

    config BT_HCI_IPC
        default y if BT

    config HEAP_MEM_POOL_ADD_SIZE_BOARD
        int
        default 4096 if BT_HCI_IPC

    config NRF_RPC_THREAD_STACK_SIZE
        int
        default 4096 if LIB_YKB_ESB

endif # BOARD_DACTYL_V1_NRF5340_CPUAPP_LEFT || BOARD_DACTYL_V1_NRF5340_CPUAPP_RIGHT
```

## boards/ykb/dactyl_v1/Kconfig.sysbuild
```kconfig
config YKB_BUILD_SPLIT_HALVES
  bool "Build both split halves (left/right)"
  default y

if SUPPORT_NETCORE

config SUPPORT_NETCORE_CPUNET_MPSL
	default y

choice NETCORE
	default NETCORE_CPUNET_MPSL if NETCORE_REMOTE_BOARD_TARGET_CPUCLUSTER != ""
endchoice

endif # SUPPORT_NETCORE
```

## boards/ykb/dactyl_v1/board.yml
```yaml
board:
  name: dactyl_v1 
  full_name: YKB Dactyl V1
  vendor: ykb
  socs:
  - name: 'nrf5340'
    variants:
    - name: 'left'
      cpucluster: 'cpuapp'
    - name: 'right'
      cpucluster: 'cpuapp'
```

## boards/ykb/dactyl_v1/cpuapp/defconfig
```kconfig
# Enable MPU
CONFIG_ARM_MPU=y

# Enable hardware stack protection
CONFIG_HW_STACK_PROTECTION=y

# Enable TrustZone-M
CONFIG_ARM_TRUSTZONE_M=y

# Enable GPIO
CONFIG_GPIO=y

# Enable UART driver
CONFIG_SERIAL=y

# Enable console
CONFIG_CONSOLE=y
CONFIG_UART_CONSOLE=y

# Enable CPUNET
CONFIG_SOC_NRF53_CPUNET_ENABLE=y

# Enable Connect libraries
CONFIG_LIB_USB_CONNECT=y
CONFIG_LIB_BT_CONNECT=y

# Enable Flash as SettingsAPI backend
CONFIG_FLASH=y
CONFIG_NVS=y
CONFIG_FLASH_PAGE_LAYOUT=y
CONFIG_FLASH_MAP=y
```

## boards/ykb/raytac_test/Kconfig.defconfig
```kconfig
if BOARD_RAYTAC_TEST_NRF5340_CPUAPP || BOARD_RAYTAC_TEST_NRF5340_CPUAPP_NS

# Workaround for not being able to have commas in macro arguments
DT_CHOSEN_Z_CODE_PARTITION := zephyr,code-partition
DT_CHOSEN_Z_SRAM_PARTITION := zephyr,sram-secure-partition

if BOARD_RAYTAC_TEST_NRF5340_CPUAPP && TRUSTED_EXECUTION_SECURE

config FLASH_LOAD_SIZE
	default $(dt_chosen_reg_size_hex,$(DT_CHOSEN_Z_CODE_PARTITION))

config SRAM_SIZE
	default $(dt_chosen_reg_size_int,$(DT_CHOSEN_Z_SRAM_PARTITION),0,K)

endif # BOARD_RAYTAC_TEST_NRF5340_CPUAPP && TRUSTED_EXECUTION_SECURE

if BOARD_RAYTAC_TEST_NRF5340_CPUAPP_NS

config FLASH_LOAD_OFFSET
	default $(dt_chosen_reg_addr_hex,$(DT_CHOSEN_Z_CODE_PARTITION))

config FLASH_LOAD_SIZE
	default $(dt_chosen_reg_size_hex,$(DT_CHOSEN_Z_CODE_PARTITION))

endif # BOARD_RAYTAC_TEST_NRF5340_CPUAPP_NS

config BT_HCI_IPC
	default y if BT

config HEAP_MEM_POOL_ADD_SIZE_BOARD
	int
	default 4096 if BT_HCI_IPC

endif # BOARD_RAYTAC_TEST_NRF5340_CPUAPP || BOARD_RAYTAC_TEST_NRF5340_CPUAPP_NS

if BOARD_RAYTAC_TEST_NRF5340_CPUNET

endif # BOARD_RAYTAC_TEST_NRF5340_CPUNET
```

## boards/ykb/raytac_test/Kconfig.raytac_test
```kconfig
config BOARD_RAYTAC_TEST
	select SOC_NRF5340_CPUAPP_QKAA if BOARD_RAYTAC_TEST_NRF5340_CPUAPP
	select SOC_NRF5340_CPUNET_QKAA if BOARD_RAYTAC_TEST_NRF5340_CPUNET
```

## boards/ykb/raytac_test/board.yml
```yaml
board:
  name: raytac_test
  full_name: Raytac MDBT53V-DB board used for testing purposes of YKB firmware
  vendor: ykb
  socs:
  - name: 'nrf5340'
    variants:
    - name: 'left'
      cpucluster: 'cpuapp'
    - name: 'right'
      cpucluster: 'cpuapp'
```

## boards/ykb/skadi/board.yml
```yaml
board:
  name: skadi 
  full_name: YKB Skadi
  vendor: ykb
  socs:
  - name: 'nrf5340'
    variants:
    - name: 'left'
      cpucluster: 'cpuapp'
    - name: 'right'
      cpucluster: 'cpuapp'
```

## drivers/Kconfig
```kconfig
menu "Drivers"
    rsource "kscan/Kconfig"
    rsource "mux/Kconfig"
    rsource "splitlink/Kconfig"
endmenu

menu "Custom Zephyr Drivers"
    rsource "charger/Kconfig"
    rsource "fuel_gauge/Kconfig"
endmenu
```

## drivers/charger/Kconfig
```kconfig
if CHARGER

    menu "Charger drivers"
        rsource "Kconfig.bq25185"
    endmenu

endif # CHARGER
```

## drivers/charger/Kconfig.bq25185
```kconfig
config CHARGER_BQ25185
	bool "BQ25185 Battery Charger"
	default y
	depends on DT_HAS_TI_BQ25185_ENABLED
	select GPIO
	help
	  Enable BQ25185 battery charger driver.
```

## drivers/fuel_gauge/Kconfig
```kconfig
if FUEL_GAUGE

    menu "Fuel-gauge drivers"
        rsource "Kconfig.ykb_fuel_gauge_voltage_divider"
    endmenu

endif
```

## drivers/fuel_gauge/Kconfig.ykb_fuel_gauge_voltage_divider
```kconfig
config FUEL_GAUGE_YKB_VOLTAGE_DIVIDER
    bool "Fuel-gauge driver based on a simple voltage divider"
    default y
    depends on DT_HAS_YKB_FUEL_GAUGE_VOLTAGE_DIVIDER_ENABLED
```

## drivers/kb_handler/Kconfig
```kconfig
menuconfig KB_HANDLER
    bool "Enable KB Handler driver"
    default y if DT_HAS_KB_HANDLER_SIMPLE_ENABLED
    default y if DT_HAS_KB_HANDLER_SPLITLINK_MASTER_ENABLED
    default y if DT_HAS_KB_HANDLER_SPLITLINK_SLAVE_ENABLED
    select KSCAN

if KB_HANDLER

    choice KB_HANDLER_IMPL
        prompt "KB Handler implementation"

        config KB_HANDLER_SIMPLE
            bool "Simple"
            depends on DT_HAS_KB_HANDLER_SIMPLE_ENABLED

        config KB_HANDLER_SPLITLINK_SLAVE
            bool "Splitlink (slave)"
            depends on DT_HAS_KB_HANDLER_SPLITLINK_SLAVE_ENABLED
            select SPLITLINK

        config KB_HANDLER_SPLITLINK_MASTER
            bool "Splitlink (master)"
            depends on DT_HAS_KB_HANDLER_SPLITLINK_MASTER_ENABLED
            select SPLITLINK

    endchoice # KB_HANDLER_IMPL

    config KB_HANDLER_MSGQ_SIZE
        int "KB Handler message queue size"
        default 8

    config KB_HANDLER_THREAD_STACK_SIZE
        int "KB Handler thread stack size"
        default 1024

    config KB_HANDLER_THREAD_PRIORITY
        int "KB Handler thread priority"
        default 15

    config KB_HANDLER_REPORT_ROLLOVER
        bool "Enable rollover error when more than 6 keys are pressed at once"
        default y

    module = KB_HANDLER
    module-str = kb_handler
    source "subsys/logging/Kconfig.template.log_config"

    rsource "Kconfig.simple"
    rsource "Kconfig.splitlink_master"
    rsource "Kconfig.splitlink_slave"

endif # KB_HANDLER
```

## drivers/kscan/Kconfig
```kconfig
menuconfig KSCAN
    bool "Enable KScan driver"
    default y if DT_HAS_KSCAN_ENABLES_ENABLED || DT_HAS_KSCAN_CHANNELS_ENABLED || DT_HAS_KSCAN_MUXES_ENABLED
    select ADC

if KSCAN

    module = KSCAN
    module-str = kscan
    source "subsys/logging/Kconfig.template.log_config"

    rsource "Kconfig.muxes"
    rsource "Kconfig.enables"
    rsource "Kconfig.channels"

endif # KSCAN
```

## drivers/kscan/Kconfig.channels
```kconfig
config KSCAN_CHANNELS
    bool "Enable KScan driver for polling with channels"
    default y if DT_HAS_KSCAN_CHANNELS_ENABLED

if KSCAN_CHANNELS

    config KSCAN_CHANNELS_THREAD_STACK_SIZE
        int "KScan Channels thread stack size (each channel)"
        default 1024

    config KSCAN_CHANNELS_THREAD_PRIORITY
        int "KScan Channels thread priority (each channel)"
        default 15

endif # KSCAN_CHANNELS
```

## drivers/kscan/Kconfig.enables
```kconfig
config KSCAN_ENABLES
    bool "Enable KScan driver for polling with enable pins"
    default y if DT_HAS_KSCAN_ENABLES_ENABLED
    select GPIO

if KSCAN_ENABLES

    config KSCAN_ENABLES_THREAD_STACK_SIZE
        int "KScan Enables thread stack size"
        default 1024

    config KSCAN_ENABLES_THREAD_PRIORITY
        int "KScan Enables thread priority"
        default 15

endif # KSCAN_ENABLES
```

## drivers/kscan/Kconfig.muxes
```kconfig
config KSCAN_MUXES
    bool "Enable KScan driver for polling with multiplexors"
    default y if DT_HAS_KSCAN_MUXES_ENABLED
    select MUX

if KSCAN_MUXES

    config KSCAN_MUXES_THREAD_STACK_SIZE
        int "KScan MUXes thread stack size (each channel)"
        default 1024

    config KSCAN_MUXES_THREAD_PRIORITY
        int "KScan MUXes thread priority (each channel)"
        default 15

endif # KSCAN_MUXES
```
